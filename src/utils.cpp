#include <Arduino.h>
#include "config.h"
#include "sensors.h"
#include "utils.h"

// CRC8 table
static const uint8_t CRC8_TABLE[256] = {
  0x00, 0x07, 0x0E, 0x09, 0x1C, 0x1B, 0x12, 0x15,
  0x38, 0x3F, 0x36, 0x31, 0x24, 0x23, 0x2A, 0x2D,
  0x70, 0x77, 0x7E, 0x79, 0x6C, 0x6B, 0x62, 0x65,
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  0x80, 0x87, 0x8E, 0x89, 0x9C, 0x9B, 0x92, 0x95
};

// Debug output
void debug_print_sensors() {
  sensors_data_t* data = sensors_get_data();
  
  Serial.print("[DEBUG] Tверх=");
  if (data->aht10_top_valid) {
    Serial.print(data->temp_top, 1);
  } else {
    Serial.print("ERR");
  }
  
  Serial.print(" Tниз=");
  if (data->aht10_bottom_valid) {
    Serial.print(data->temp_bottom, 1);
  } else {
    Serial.print("ERR");
  }
  
  Serial.print(" Hверх=");
  if (data->aht10_top_valid) {
    Serial.print((int)data->humidity_top);
  } else {
    Serial.print("ERR");
  }
  
  Serial.print(" Hниз=");
  if (data->aht10_bottom_valid) {
    Serial.print((int)data->humidity_bottom);
  } else {
    Serial.print("ERR");
  }
  
  Serial.print(" Tбак=");
  if (data->ds18b20_valid) {
    Serial.print(data->temp_tank, 1);
  } else {
    Serial.print("ERR");
  }
  
  Serial.print(" Tср=");
  Serial.print(data->temp_avg, 1);
  
  Serial.print(" Hср=");
  Serial.print((int)data->humidity_avg);
  
  Serial.print(" dT/dt=");
  Serial.print(sensors_get_temp_change_rate(), 2);
  
  Serial.println();
}

// CRC8 calculation
uint8_t crc8(uint8_t* data, uint8_t length) {
  uint8_t crc = 0;
  for (uint8_t i = 0; i < length; i++) {
    crc = CRC8_TABLE[crc ^ data[i]];
  }
  return crc;
}
